## CMakeLists.txt
```
# SPDX-License-Identifier: Apache-2.0

cmake_minimum_required(VERSION 3.20.0)
find_package(Zephyr REQUIRED HINTS $ENV{ZEPHYR_BASE})
project(beacon)

target_sources(app PRIVATE 
 src/main.c
 src/advertiser.c
 src/observer.c
 )
```

## prj.conf
```kconfig
CONFIG_LOG=y
CONFIG_GPIO=y
CONFIG_BT_DEVICE_NAME="Kostakiss NEW SUPER Beacon"
CONFIG_BT=y
CONFIG_BT_CTLR=y
CONFIG_BT_CTLR_TX_PWR_DYNAMIC_CONTROL=y
CONFIG_BT_HCI_VS=y
CONFIG_BT_PERIPHERAL=y
CONFIG_BT_HRS=y
CONFIG_BT_CTLR_ADVANCED_FEATURES=y
CONFIG_BT_CTLR_CONN_RSSI=y
CONFIG_BT_CTLR_TX_PWR_PLUS_8=y


CONFIG_BT_WAIT_NOP=n
CONFIG_BT_OBSERVER=y
CONFIG_BT_EXT_ADV=y
CONFIG_BT_SCAN=y
CONFIG_BT_SCAN_FILTER_ENABLE=y
CONFIG_BT_SCAN_UUID_CNT=2
#CONFIG_BT_SCAN_WITH_IDENTITY=y
CONFIG_SYSTEM_WORKQUEUE_STACK_SIZE=8192
CONFIG_COUNTER=y
```

## boards/nrf52840dk_nrf52840.overlay
```dts
/*
 * Copyright 2022 Dronetag
 *
 * SPDX-License-Identifier: Apache-2.0
 */
/{
	coex_gpio: coex {
		compatible = "gpio-radio-coex";
		grant-gpios = <&gpio1 0 (GPIO_PULL_DOWN | GPIO_ACTIVE_LOW)>;
		grant-delay-us = <150>;
	};
};

&radio {
	coex = <&coex_gpio>;
};


&rtc2 {
	status = "okay";
};
```

## src/main.c
```c
#include <zephyr/types.h>
#include <stddef.h>
#include <zephyr/sys/printk.h>
#include <zephyr/sys/util.h>
#include <zephyr/drivers/gpio.h>
#include <zephyr/bluetooth/bluetooth.h>
#include <zephyr/kernel.h>  // For k_timer 
#include <zephyr/drivers/counter.h>
#include <zephyr/device.h>
#include <bluetooth/scan.h>

#include <zephyr/bluetooth/hci.h>// /* main.c - Application main entry point */
#include <zephyr/bluetooth/hci_vs.h>
#include <zephyr/sys/byteorder.h>
#include <zephyr/bluetooth/uuid.h> //extra

#define DEVICE_NAME CONFIG_BT_DEVICE_NAME
#define DEVICE_NAME_LEN (sizeof(DEVICE_NAME) - 1)

#define ALARM_CHANNEL_ID 0
#define TIMER DT_NODELABEL(rtc2)

#define MAX_SLEEP_DUR 12000
#define MIN_SLEEP_DUR 200

/* adv model parameters */
extern int current_min_interval;
extern int current_max_interval;
extern int Tx_id;
extern bool tx_on;

/* Observer model parameters*/
uint16_t scan_interval = (uint16_t) 960; // 600ms
uint16_t scan_window = (uint16_t) 80; // 50ms

extern int no_packets;

uint64_t counter_timeout = 2000000; // 2s
int sleep_dur = 1000; // 1s
int previous_norm=-1;

// advertise functions //
void adv_start();
void adv_reset();
void adv_stop();

// Observer function //
int  observer_start(uint16_t interval, uint16_t window);
void observer_stop();
void scan_reset(uint16_t interval, uint16_t window); 

const struct device *const counter_dev = DEVICE_DT_GET(TIMER);
struct counter_alarm_cfg alarm_cfg;

static void counter_interrupt_fn(const struct device *counter_dev, uint8_t chan_id, uint32_t ticks, void *user_data);

static void sleep_work_handler(struct k_work *work)
{
    k_sleep(K_MSEC(sleep_dur));
    k_sleep(K_MSEC(sleep_dur));
    k_sleep(K_MSEC(sleep_dur));
    k_sleep(K_MSEC(sleep_dur));
    k_sleep(K_MSEC(sleep_dur));
    k_sleep(K_MSEC(sleep_dur));
    k_sleep(K_MSEC(sleep_dur));
    k_sleep(K_MSEC(sleep_dur));
    k_sleep(K_MSEC(sleep_dur));
    k_sleep(K_MSEC(sleep_dur));

    alarm_cfg.flags = 0;
    alarm_cfg.ticks = counter_us_to_ticks(counter_dev, counter_timeout);
    alarm_cfg.callback = counter_interrupt_fn;
    alarm_cfg.user_data = &alarm_cfg;

    int err = counter_set_channel_alarm(counter_dev, ALARM_CHANNEL_ID, &alarm_cfg);
    if (err != 0) {
        printk("Alarm could not be set\n");
    }
}

K_WORK_DEFINE(sleep_work, sleep_work_handler);

static void counter_interrupt_fn(const struct device *counter_dev,
				      uint8_t chan_id, uint32_t ticks,
				      void *user_data)
{

    	struct counter_alarm_cfg *config = user_data;

		printk("Counter interrupt\n");

        int packet_time = (int)((counter_timeout / (scan_interval + scan_window)) * scan_window); 
        int norm_packets = (int)(no_packets * 1000000 / packet_time);  

        printk("No of packets %d Packet time %d Norm packets %d\n", no_packets, packet_time, norm_packets);

        if (previous_norm == -1) {
            previous_norm = norm_packets;
        }
       
        if (norm_packets == 0)
        {
            if (previous_norm == 0) 
            {
                sleep_dur += 200;
                if (sleep_dur > MAX_SLEEP_DUR) sleep_dur = MAX_SLEEP_DUR;
            }
            observer_stop(); // Stop scanning
            adv_stop(); // Stop advertising
            k_work_submit(&sleep_work);
            scan_reset(scan_interval, scan_window);
        }
        else
        {  
            if(norm_packets > previous_norm)
            {   
                sleep_dur -= 100;
                if (sleep_dur < MIN_SLEEP_DUR) sleep_dur = MIN_SLEEP_DUR;
                if (previous_norm == 0) adv_reset();
            }
            else if(norm_packets < previous_norm)
            {
                sleep_dur += 100;
                if (sleep_dur > MAX_SLEEP_DUR) sleep_dur = MAX_SLEEP_DUR;
            }

            alarm_cfg.flags = 0;
            alarm_cfg.ticks = counter_us_to_ticks(counter_dev, counter_timeout);
            alarm_cfg.callback = counter_interrupt_fn;
            alarm_cfg.user_data = &alarm_cfg;

            int err = counter_set_channel_alarm(counter_dev, ALARM_CHANNEL_ID, &alarm_cfg);
            if (err != 0) {
                printk("Alarm could not be set\n");
            }

        }

        previous_norm = norm_packets;
        no_packets = 0;
} 

/* Bluetooth ready callback */

static void bt_ready(int err)
{
    if (err) {
        printk("Bluetooth init failed (err %d)\n", err);
        return;
    }

    printk("Bluetooth initialized\n");

    (void)observer_start(scan_interval, scan_window);

    adv_start();
}

int main(void)
{
  //  const struct device *const counter_dev = DEVICE_DT_GET(TIMER);
    int err;

    printk("Starting Beacon DION Demo\n");

    if (!device_is_ready(counter_dev)) {
		printk("device not ready.\n");
		return 0;
	}

    counter_start(counter_dev);

	alarm_cfg.flags = 0;
	alarm_cfg.ticks = counter_us_to_ticks(counter_dev, counter_timeout);
	alarm_cfg.callback = counter_interrupt_fn;
	alarm_cfg.user_data = &alarm_cfg;

    err = counter_set_channel_alarm(counter_dev, ALARM_CHANNEL_ID, &alarm_cfg); 

	if (-EINVAL == err) {
		printk("Alarm settings invalid\n");
	} else if (-ENOTSUP == err) {
		printk("Alarm setting request not supported\n");
	} else if (err != 0) {
		printk("Error\n");
	}

    /* Initialize the Bluetooth Subsystem */
    err = bt_enable(bt_ready);
    if (err) {
        printk("Bluetooth init failed (err %d)\n", err);
    }  

    return 0;
}
```

## src/advertiser.c
```c
#include <zephyr/types.h>
#include <stddef.h>
#include <zephyr/sys/printk.h>
#include <zephyr/sys/util.h>
#include <zephyr/drivers/gpio.h>
#include <zephyr/bluetooth/bluetooth.h>
#include <zephyr/bluetooth/hci.h>
#include <zephyr/kernel.h>  // For k_timer 

#include <zephyr/bluetooth/hci.h>
#include <zephyr/bluetooth/hci_vs.h>
#include <zephyr/sys/byteorder.h>
#include <zephyr/bluetooth/uuid.h> //extra

#define DEVICE_NAME CONFIG_BT_DEVICE_NAME
#define DEVICE_NAME_LEN (sizeof(DEVICE_NAME) - 1)

//model parameters
int current_min_interval = 160;
int current_max_interval = 208; 
int Tx_id = 0;
bool tx_on = false; 
bool adv_started = false;

//static parameters
static struct bt_le_adv_param adv_param;
static const int8_t txpower[8] = {8, 4, 0, -4,-8,-12, -16, -20}; // hight --> low  Tx power  , (-62 dbm to -30dbm) //-20 to +8 dBm TX power, configurable in 4 dB steps

/* Advertisement data */
static const struct bt_data ad[] = {
    BT_DATA_BYTES(BT_DATA_FLAGS, BT_LE_AD_NO_BREDR),
    BT_DATA_BYTES(BT_DATA_UUID16_ALL, 0xaa, 0xde),
};

// tx functions // 
static void set_tx_power(uint8_t handle_type, uint16_t handle, int8_t tx_pwr_lvl)
{
	struct bt_hci_cp_vs_write_tx_power_level *cp;
	struct bt_hci_rp_vs_write_tx_power_level *rp;
	struct net_buf *buf, *rsp = NULL;
	int err;

	buf = bt_hci_cmd_create(BT_HCI_OP_VS_WRITE_TX_POWER_LEVEL,
				sizeof(*cp));
	if (!buf) {
		printk("Unable to allocate command buffer\n");
		return;
	}

	cp = net_buf_add(buf, sizeof(*cp));
	cp->handle = sys_cpu_to_le16(handle);
	cp->handle_type = handle_type;
	cp->tx_power_level = tx_pwr_lvl;

	err = bt_hci_cmd_send_sync(BT_HCI_OP_VS_WRITE_TX_POWER_LEVEL,
				   buf, &rsp);
	if (err) {
		printk("Set Tx power err: %d\n", err);
		return;
	}

	rp = (void *)rsp->data;
	printk("Actual Tx Power: %d\n", rp->selected_tx_power);

	net_buf_unref(rsp);
}

static void get_tx_power(uint8_t handle_type, uint16_t handle, int8_t *tx_pwr_lvl)
{
	struct bt_hci_cp_vs_read_tx_power_level *cp;
	struct bt_hci_rp_vs_read_tx_power_level *rp;
	struct net_buf *buf, *rsp = NULL;
	int err;

	*tx_pwr_lvl = 0xFF;
	buf = bt_hci_cmd_create(BT_HCI_OP_VS_READ_TX_POWER_LEVEL,
				sizeof(*cp));
	if (!buf) {
		printk("Unable to allocate command buffer\n");
		return;
	}

	cp = net_buf_add(buf, sizeof(*cp));
	cp->handle = sys_cpu_to_le16(handle);
	cp->handle_type = handle_type;

	err = bt_hci_cmd_send_sync(BT_HCI_OP_VS_READ_TX_POWER_LEVEL,
				   buf, &rsp);
	if (err) {
		printk("Read Tx power err: %d\n", err);
		return;
	}

	rp = (void *)rsp->data;
	*tx_pwr_lvl = rp->tx_power_level;

	net_buf_unref(rsp);
}

//Help functions// 
static void print_tx() { 
    int8_t txp_get= 0;
    printk("Get Tx power level -> ");
	get_tx_power(BT_HCI_VS_LL_HANDLE_TYPE_ADV,0, &txp_get);
	printk("TXP = %d\n", txp_get);
}

static void set_tx(int Tx_id){ 
    printk("Set Tx power level to %d\n", txpower[Tx_id]);
	set_tx_power(BT_HCI_VS_LL_HANDLE_TYPE_ADV,0, txpower[Tx_id]);
}


//K_TIMER_DEFINE(adv_timer, start_advertising_handler, NULL);

/* Global Functions */
void adv_start()
{
    adv_param = (struct bt_le_adv_param)BT_LE_ADV_PARAM_INIT(BT_LE_ADV_OPT_SCANNABLE | BT_LE_ADV_OPT_NOTIFY_SCAN_REQ | BT_LE_ADV_OPT_USE_IDENTITY,
                                                        current_min_interval,
                                                        current_max_interval,
                                                        NULL); 


    /* Start advertising */ 

	int err;

	//set-1 default//
    err = bt_le_adv_start(&adv_param, ad, ARRAY_SIZE(ad), NULL, 0); //set scan respone data to NULL 
    if (err) {
        printk("Advertising failed to start (err %d)\n", err);
        return;
    }

	//k_timer_init(&adv_timer, adv_timer_handler, NULL);
    
	adv_started = true;
	printk("Advertise start ..\n");  
}

//handler functions//
static void start_advertising_handler(struct k_work *work)
{   
    if(adv_started) { bt_le_adv_stop();} 

    adv_param =  (struct bt_le_adv_param)BT_LE_ADV_PARAM_INIT(BT_LE_ADV_OPT_SCANNABLE|BT_LE_ADV_OPT_NOTIFY_SCAN_REQ ,
                                                        current_min_interval,
                                                        current_max_interval,
                                                        NULL); 
    
    int err;
    err = bt_le_adv_start(&adv_param, ad, ARRAY_SIZE(ad), NULL, 0);
    if (err) {
        printk("Advertising failed to start (err %d)\n", err);
        return;
    }

	adv_started = true;
    
    if(tx_on) set_tx(Tx_id);

    printk("Exiting adv_reset handler..\n");

}

K_WORK_DEFINE(start_advertising_work, start_advertising_handler);

void adv_reset() { 
       
        // Submit work to start advertising
        k_work_submit(&start_advertising_work);
        printk("Exiting adv_reset..\n");
}

static void adv_stop_handler(struct k_work *work)
{
	int err = bt_le_adv_stop();
	if (err) {
		printk("Advertising failed to stop (err %d)\n", err);
		return;
	}

    adv_started = false;
	printk("Exiting adv_stop handler..\n");

	return;
}

K_WORK_DEFINE(adv_stop_work, adv_stop_handler);

void adv_stop()
{
	k_work_submit(&adv_stop_work);

	printk("Exiting adv_stop..\n");

	return;
}
```

## src/observer.c
```c
#include <zephyr/sys/printk.h>
#include <zephyr/bluetooth/bluetooth.h>
#include <zephyr/bluetooth/hci.h>
#include <bluetooth/scan.h>
#include <zephyr/bluetooth/uuid.h>

uint16_t no_packets=0;	

bool scan_stopped = false;

static void scan_filter_match(struct bt_scan_device_info *device_info,
			      struct bt_scan_filter_match *filter_match,
			      bool connectable)
{
	++no_packets;

	//printk("MATCH: No of FILTERED packets %u\n", no_packets);
	
}

struct bt_le_scan_param scan_param;

BT_SCAN_CB_INIT(scan_cb, scan_filter_match, NULL, NULL, NULL);


static int scan_init()
{	

	struct bt_scan_init_param scan_init = {
		.scan_param = &scan_param,
	};

	bt_scan_init(&scan_init); // Stores the scanning parameters we set at scan_param struct and the default conn params in bt_scan struct

	printk("Scan window %u, Scan interval %u\n", scan_param.window, scan_param.interval);

	bt_scan_cb_register(&scan_cb);

	int err;


	static struct bt_uuid_16 my_uuid = BT_UUID_INIT_16(0xBEAA);

	err = bt_scan_filter_add(BT_SCAN_FILTER_TYPE_UUID, &my_uuid);
	if (err) {
		printk("Scanning filters cannot be set (err %d)", err);
		return err;
	}

	err = bt_scan_filter_enable(BT_SCAN_UUID_FILTER, false);
	if (err) {
		printk("Filters cannot be turned on (err %d)", err);
		return err;
	}

	printk("Scan module initialized\n");
	return err;
}

int observer_start(uint16_t interval, uint16_t window)
{
	scan_param.options	= BT_LE_SCAN_OPT_NONE;
	scan_param.interval	= interval;
	scan_param.window	= window;

	int err;

	err = scan_init();

	if (err) {
		printk("scan_init failed (err %d)\n", err);
		return err;
	}

	err = bt_scan_start(BT_SCAN_TYPE_SCAN_PASSIVE);
	if (err) {
		printk("Start scanning failed (err %d)\n", err);
		return err;
	}

	printk("Scanning successfully started\n");

	return err;
}

static void scan_reset_work_handler(struct k_work *work)
{
	int err;

	printk("Scan window %u, Scan interval %u\n", scan_param.window, scan_param.interval);

	if (!scan_stopped)
	{
		err = bt_scan_params_set(&scan_param);

		if (err) {
			printk("Failed to set new scan parameters (err %d)\n", err);
		}

		printk("Reset parameters: SUCCESS\n");
	}

	err = bt_scan_start(BT_SCAN_TYPE_SCAN_PASSIVE);

	if (err) {
		printk("Scanning failed to start (err %d)\n", err);
	}

	if (scan_stopped) scan_stopped = false;

	printk("Exiting observer_reset handler..\n");

	return;
}

K_WORK_DEFINE(scan_reset_work, scan_reset_work_handler);

void scan_reset(uint16_t interval, uint16_t window)
{

	no_packets = 0;
	scan_param.interval	= interval;
	scan_param.window	= window;

    k_work_submit(&scan_reset_work);

	printk("Exiting observer_reset..\n");

	return;
}

static void observer_stop_handler(struct k_work *work)
{
	int err;

	scan_stopped = true;

	err = bt_scan_stop();
	if (err) {
		printk("Stop scanning failed (err %d)\n", err);
	}

	printk("Exiting observer_stop handler..\n");

	return;
}

K_WORK_DEFINE(observer_stop_work, observer_stop_handler);

void observer_stop()
{
	k_work_submit(&observer_stop_work);

	printk("Exiting observer_stop..\n");

	return;
}
```
